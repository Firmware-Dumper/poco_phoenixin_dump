/dts-v1/;

/ {
	model = "Qualcomm Technologies, Inc. SA6155 ADP-STAR";
	compatible = "qcom,sa6155-adp-star", "qcom,sa6155", "qcom,adp-star";
	qcom,msm-id = <0x180 0x00>;
	qcom,board-id = <0x10019 0x00>;

	fragment@0 {
		target = <0xffffffff>;

		__overlay__ {

			vreg_conn_1p8 {
				compatible = "regulator-fixed";
				regulator-name = "vreg_conn_1p8";
				startup-delay-us = <0xfa0>;
				enable-active-high;
				gpio = <0xffffffff 0x01 0x00>;
				phandle = <0x02>;
			};

			vreg_conn_pa {
				compatible = "regulator-fixed";
				regulator-name = "vreg_conn_pa";
				startup-delay-us = <0xfa0>;
				enable-active-high;
				gpio = <0xffffffff 0x06 0x00>;
				phandle = <0x01>;
			};

			vreg_wlan {
				compatible = "qcom,stub-regulator";
				regulator-name = "vreg_wlan";
				phandle = <0x03>;
			};

			bt_qca6174 {
				compatible = "qca,qca6174";
				pinctrl-names = "default";
				pinctrl-0 = <0xffffffff>;
				qca,bt-reset-gpio = <0xffffffff 0x55 0x00>;
				qca,bt-vdd-pa-supply = <0x01>;
				qca,bt-chip-pwd-supply = <0x02>;
				qca,bt-vdd-vm-supply = <0xffffffff>;
				qca,bt-vdd-5a-supply = <0xffffffff>;
				qca,bt-vdd-vh-supply = <0xffffffff>;
				qca,bt-vdd-vm-voltage-level = <0x149970 0x149970>;
				qca,bt-vdd-5a-voltage-level = <0x1f20c0 0x1f20c0>;
				qca,bt-vdd-vh-voltage-level = <0x1d0d80 0x1d0d80>;
				qca,bt-vdd-vm-current-level = <0x00>;
				qca,bt-vdd-5a-current-level = <0x00>;
				qca,bt-vdd-vh-current-level = <0x6ddd0>;
				status = "ok";
				phandle = <0x04>;
			};

			qcom,cnss-qca-converged {
				compatible = "qcom,cnss-qca-converged";
				qcom,converged-dt;
				qcom,wlan-rc-num = <0x00>;
				qcom,bus-type = <0x00>;
				qcom,notify-modem-status;
				qcom,msm-bus,name = "msm-cnss";
				qcom,msm-bus,num-cases = <0x04>;
				qcom,msm-bus,num-paths = <0x02>;
				qcom,msm-bus,vectors-KBps = <0x2d 0x200 0x00 0x00 0x01 0x200 0x00 0x00 0x2d 0x200 0xa1cd 0xa0000 0x01 0x200 0xa1cd 0xa0000 0x2d 0x200 0x1810c 0xa0000 0x01 0x200 0x1810c 0x186a00 0x2d 0x200 0x32904 0x118000 0x01 0x200 0x32904 0x2faf00>;
				#address-cells = <0x01>;
				#size-cells = <0x01>;
				ranges = <0x10000000 0x10000000 0x10000000 0x20000000 0x20000000 0x10000 0xa0000000 0xa0000000 0x10000000 0xb0000000 0xb0000000 0x10000>;
				vdd-wlan-ctrl1-supply = <0x01>;
				vdd-wlan-ctrl2-supply = <0x02>;
				vdd-wlan-supply = <0x03>;
				vdd-wlan-rfa1-supply = <0xffffffff>;
				vdd-wlan-rfa2-supply = <0xffffffff>;
				vdd-wlan-rfa3-supply = <0xffffffff>;
				wlan_vregs = "vdd-wlan-ctrl1", "vdd-wlan-ctrl2";
				qcom,vdd-wlan-ctrl1-info = <0x00 0x00 0x00 0x00>;
				qcom,vdd-wlan-ctrl2-info = <0x00 0x00 0x00 0x00>;
				wlan-en-gpio = <0xffffffff 0x62 0x00>;
				pinctrl-names = "wlan_en_active", "wlan_en_sleep";
				pinctrl-0 = <0xffffffff>;
				pinctrl-1 = <0xffffffff>;
				phandle = <0x05>;

				chip_cfg@0 {
					reg = <0x10000000 0x10000000 0x20000000 0x10000>;
					reg-names = "smmu_iova_base", "smmu_iova_ipa";
					supported-ids = <0x3e>;
					wlan_vregs = "vdd-wlan";
					qcom,vdd-wlan-info = <0x00 0x00 0x00 0x0a>;
					qcom,smmu-s1-enable;
					qcom,wlan-ramdump-dynamic = <0x200000>;
				};

				chip_cfg@1 {
					reg = <0xa0000000 0x10000000 0xb0000000 0x10000>;
					reg-names = "smmu_iova_base", "smmu_iova_ipa";
					supported-ids = <0x1101>;
					wlan_vregs = "vdd-wlan-rfa1", "vdd-wlan-rfa2", "vdd-wlan-rfa3";
					qcom,vdd-wlan-rfa1-info = <0x149970 0x149970 0x00 0x00>;
					qcom,vdd-wlan-rfa2-info = <0x1f20c0 0x1f20c0 0x00 0x00>;
					qcom,vdd-wlan-rfa3-info = <0x1d0d80 0x1d0d80 0x00 0x00>;
					qcom,wlan-ramdump-dynamic = <0x400000>;
					mhi,max-channels = <0x1e>;
					mhi,timeout = <0x2710>;

					mhi_channels {

						mhi_chan@0 {
							reg = <0x00>;
							label = "LOOPBACK";
							mhi,num-elements = <0x20>;
							mhi,event-ring = <0x01>;
							mhi,chan-dir = <0x01>;
							mhi,data-type = <0x00>;
							mhi,doorbell-mode = <0x02>;
							mhi,ee = <0x14>;
						};

						mhi_chan@1 {
							reg = <0x01>;
							label = "LOOPBACK";
							mhi,num-elements = <0x20>;
							mhi,event-ring = <0x01>;
							mhi,chan-dir = <0x02>;
							mhi,data-type = <0x00>;
							mhi,doorbell-mode = <0x02>;
							mhi,ee = <0x14>;
						};

						mhi_chan@4 {
							reg = <0x04>;
							label = "DIAG";
							mhi,num-elements = <0x20>;
							mhi,event-ring = <0x01>;
							mhi,chan-dir = <0x01>;
							mhi,data-type = <0x00>;
							mhi,doorbell-mode = <0x02>;
							mhi,ee = <0x14>;
						};

						mhi_chan@5 {
							reg = <0x05>;
							label = "DIAG";
							mhi,num-elements = <0x20>;
							mhi,event-ring = <0x01>;
							mhi,chan-dir = <0x02>;
							mhi,data-type = <0x00>;
							mhi,doorbell-mode = <0x02>;
							mhi,ee = <0x14>;
						};

						mhi_chan@20 {
							reg = <0x14>;
							label = "IPCR";
							mhi,num-elements = <0x20>;
							mhi,event-ring = <0x01>;
							mhi,chan-dir = <0x01>;
							mhi,data-type = <0x01>;
							mhi,doorbell-mode = <0x02>;
							mhi,ee = <0x14>;
							mhi,auto-start;
						};

						mhi_chan@21 {
							reg = <0x15>;
							label = "IPCR";
							mhi,num-elements = <0x20>;
							mhi,event-ring = <0x01>;
							mhi,chan-dir = <0x02>;
							mhi,data-type = <0x00>;
							mhi,doorbell-mode = <0x02>;
							mhi,ee = <0x14>;
							mhi,auto-queue;
							mhi,auto-start;
						};
					};

					mhi_events {

						mhi_event@0 {
							mhi,num-elements = <0x20>;
							mhi,intmod = <0x01>;
							mhi,msi = <0x01>;
							mhi,priority = <0x01>;
							mhi,brstmode = <0x02>;
							mhi,data-type = <0x01>;
						};

						mhi_event@1 {
							mhi,num-elements = <0x100>;
							mhi,intmod = <0x01>;
							mhi,msi = <0x02>;
							mhi,priority = <0x01>;
							mhi,brstmode = <0x02>;
						};
					};
				};

				chip_cfg@2 {
					reg = <0xa0000000 0x10000000 0xb0000000 0x10000>;
					reg-names = "smmu_iova_base", "smmu_iova_ipa";
					supported-ids = <0x1102>;
					wlan_vregs = "vdd-wlan-rfa1", "vdd-wlan-rfa2", "vdd-wlan-rfa3";
					qcom,vdd-wlan-rfa1-info = <0x149970 0x149970 0x00 0x00>;
					qcom,vdd-wlan-rfa2-info = <0x1f20c0 0x1f20c0 0x00 0x00>;
					qcom,vdd-wlan-rfa3-info = <0x1d0d80 0x1d0d80 0x00 0x00>;
					qcom,wlan-ramdump-dynamic = <0x300000>;
					mhi,max-channels = <0x1e>;
					mhi,timeout = <0x2710>;
					mhi,ee = <0x03 0x04>;
					mhi,ee-names = "SBL", "RDDM";
					mhi,bhie-offset = <0x324>;

					mhi_channels {
						#address-cells = <0x01>;
						#size-cells = <0x00>;

						mhi_chan@0 {
							reg = <0x00>;
							label = "LOOPBACK";
							mhi,num-elements = <0x20>;
							mhi,event-ring = <0x01>;
							mhi,chan-dir = <0x01>;
							mhi,data-type = <0x00>;
							mhi,doorbell-mode = <0x02>;
							mhi,ee = <0x14>;
						};

						mhi_chan@1 {
							reg = <0x01>;
							label = "LOOPBACK";
							mhi,num-elements = <0x20>;
							mhi,event-ring = <0x01>;
							mhi,chan-dir = <0x02>;
							mhi,data-type = <0x00>;
							mhi,doorbell-mode = <0x02>;
							mhi,ee = <0x14>;
						};

						mhi_chan@4 {
							reg = <0x04>;
							label = "DIAG";
							mhi,num-elements = <0x20>;
							mhi,event-ring = <0x01>;
							mhi,chan-dir = <0x01>;
							mhi,data-type = <0x00>;
							mhi,doorbell-mode = <0x02>;
							mhi,ee = <0x14>;
						};

						mhi_chan@5 {
							reg = <0x05>;
							label = "DIAG";
							mhi,num-elements = <0x20>;
							mhi,event-ring = <0x01>;
							mhi,chan-dir = <0x02>;
							mhi,data-type = <0x00>;
							mhi,doorbell-mode = <0x02>;
							mhi,ee = <0x14>;
						};

						mhi_chan@16 {
							reg = <0x10>;
							label = "IPCR";
							mhi,num-elements = <0x20>;
							mhi,event-ring = <0x01>;
							mhi,chan-dir = <0x01>;
							mhi,data-type = <0x01>;
							mhi,doorbell-mode = <0x02>;
							mhi,ee = <0x14>;
							mhi,auto-start;
						};

						mhi_chan@17 {
							reg = <0x11>;
							label = "IPCR";
							mhi,num-elements = <0x20>;
							mhi,event-ring = <0x01>;
							mhi,chan-dir = <0x02>;
							mhi,data-type = <0x00>;
							mhi,doorbell-mode = <0x02>;
							mhi,ee = <0x14>;
							mhi,auto-queue;
							mhi,auto-start;
						};
					};

					mhi_events {

						mhi_event@0 {
							mhi,num-elements = <0x20>;
							mhi,intmod = <0x01>;
							mhi,msi = <0x01>;
							mhi,priority = <0x01>;
							mhi,brstmode = <0x02>;
							mhi,data-type = <0x01>;
						};

						mhi_event@1 {
							mhi,num-elements = <0x100>;
							mhi,intmod = <0x01>;
							mhi,msi = <0x02>;
							mhi,priority = <0x01>;
							mhi,brstmode = <0x02>;
						};
					};
				};
			};
		};
	};

	fragment@1 {
		target = <0xffffffff>;

		__overlay__ {
			status = "ok";
		};
	};

	fragment@2 {
		target = <0xffffffff>;

		__overlay__ {
			status = "ok";

			can-controller@0 {
				compatible = "qcom,nxp,mpc5746c";
				reg = <0x00>;
				interrupt-parent = <0xffffffff>;
				interrupts = <0x28 0x00>;
				spi-max-frequency = <0x4c4b40>;
				qcom,clk-freq-mhz = <0x2625a00>;
				qcom,max-can-channels = <0x01>;
				qcom,bits-per-word = <0x08>;
				qcom,support-can-fd;
			};
		};
	};

	fragment@3 {
		target = <0xffffffff>;

		__overlay__ {

			qcom,lpass@62400000 {
				status = "ok";
			};

			qcom,glink {

				modem {
					status = "disabled";
				};
			};

			qcom,hsi2s {
				compatible = "qcom,sa6155-hsi2s", "qcom,hsi2s";
				number-of-interfaces = <0x02>;
				reg = <0x1b40000 0x28000>;
				reg-names = "lpa_if";
				interrupts = <0x00 0x10b 0x00>;
				clocks = <0xffffffff 0xb0 0xffffffff 0xb1 0xffffffff 0xb2 0xffffffff 0xb3 0xffffffff 0xb4>;
				clock-names = "core_clk", "wr0_mem_clk", "wr1_mem_clk", "wr2_mem_clk", "csr_hclk";
				number-of-rate-detectors = <0x02>;
				rate-detector-interfaces = <0x00 0x01>;
				phandle = <0x06>;

				qcom,hs0_i2s {
					compatible = "qcom,hsi2s-interface";
					minor-number = <0x00>;
					pinctrl-names = "default", "sleep";
					pinctrl-0 = <0xffffffff 0xffffffff 0xffffffff>;
					pinctrl-1 = <0xffffffff 0xffffffff 0xffffffff>;
					clocks = <0xffffffff 0xb5>;
					clock-names = "pri_mi2s_clk";
					iommus = <0xffffffff 0x35c 0x00>;
					qcom,smmu-s1-bypass;
					qcom,iova-mapping = <0x00 0xffffffff>;
					bit-clock-hz = <0xbb8000>;
					data-buffer-ms = <0x0a>;
					bit-depth = <0x20>;
					spkr-channel-count = <0x02>;
					mic-channel-count = <0x02>;
					pcm-rate = <0x02>;
					pcm-sync-src = <0x00>;
					aux-mode = <0x00>;
					rpcm-width = <0x01>;
					tpcm-width = <0x01>;
					enable-tdm = <0x01>;
					tdm-rate = <0x20>;
					tdm-rpcm-width = <0x10>;
					tdm-tpcm-width = <0x10>;
					tdm-sync-delay = <0x02>;
					tdm-inv-sync = <0x00>;
					pcm-lane-config = <0x01>;
					phandle = <0x07>;
				};

				qcom,hs1_i2s {
					compatible = "qcom,hsi2s-interface";
					minor-number = <0x01>;
					pinctrl-names = "default", "sleep";
					pinctrl-0 = <0xffffffff 0xffffffff 0xffffffff>;
					pinctrl-1 = <0xffffffff 0xffffffff 0xffffffff>;
					clocks = <0xffffffff 0xb6>;
					clock-names = "sec_mi2s_clk";
					iommus = <0xffffffff 0x35d 0x00>;
					qcom,smmu-s1-bypass;
					qcom,iova-mapping = <0x00 0xffffffff>;
					bit-clock-hz = <0xbb8000>;
					data-buffer-ms = <0x0a>;
					bit-depth = <0x20>;
					spkr-channel-count = <0x02>;
					mic-channel-count = <0x02>;
					pcm-rate = <0x02>;
					pcm-sync-src = <0x00>;
					aux-mode = <0x00>;
					rpcm-width = <0x01>;
					tpcm-width = <0x01>;
					enable-tdm = <0x01>;
					tdm-rate = <0x20>;
					tdm-rpcm-width = <0x10>;
					tdm-tpcm-width = <0x10>;
					tdm-sync-delay = <0x02>;
					tdm-inv-sync = <0x00>;
					pcm-lane-config = <0x01>;
					phandle = <0x08>;
				};
			};

			qcom,emac@20000 {
				compatible = "qcom,emac-dwc-eqos";
				qcom,arm-smmu;
				reg = <0x20000 0x10000 0x36000 0x100>;
				reg-names = "emac-base", "rgmii-base";
				dma-bit-mask = <0x20>;
				emac-core-version = <0x07>;
				emac-phy-addr = <0x07>;
				interrupts-extended = <0xffffffff 0x00 0x294 0x04 0xffffffff 0x00 0x295 0x04 0xffffffff 0x79 0x02 0xffffffff 0x00 0x28b 0x04 0xffffffff 0x00 0x28c 0x04 0xffffffff 0x00 0x28d 0x04 0xffffffff 0x00 0x28e 0x04 0xffffffff 0x00 0x28f 0x04 0xffffffff 0x00 0x290 0x04 0xffffffff 0x00 0x291 0x04 0xffffffff 0x00 0x292 0x04 0xffffffff 0x00 0x293 0x04 0xffffffff 0x00 0x29c 0x04 0xffffffff 0x00 0x29d 0x04>;
				interrupt-names = "sbd-intr", "lpi-intr", "phy-intr", "tx-ch0-intr", "tx-ch1-intr", "tx-ch2-intr", "tx-ch3-intr", "tx-ch4-intr", "rx-ch0-intr", "rx-ch1-intr", "rx-ch2-intr", "rx-ch3-intr", "ptp_pps_irq_0", "ptp_pps_irq_1";
				qcom,msm-bus,name = "emac";
				qcom,msm-bus,num-cases = <0x04>;
				qcom,msm-bus,num-paths = <0x02>;
				qcom,msm-bus,vectors-KBps = <0x62 0x200 0x00 0x00 0x01 0x30d 0x00 0x00 0x62 0x200 0x4e2 0x00 0x01 0x30d 0x00 0x9c40 0x62 0x200 0x30d4 0x00 0x01 0x30d 0x00 0x9c40 0x62 0x200 0x1e848 0x00 0x01 0x30d 0x00 0x9c40>;
				qcom,bus-vector-names = "0", "10", "100", "1000";
				clocks = <0xffffffff 0x20 0xffffffff 0x21 0xffffffff 0x23 0xffffffff 0x25>;
				clock-names = "eth_axi_clk", "eth_ptp_clk", "eth_rgmii_clk", "eth_slave_ahb_clk";
				qcom,phy-reset = <0xffffffff 0x68 0x00>;
				qcom,phy-reset-delay-msecs = <0x0a 0x32>;
				qcom,phy-intr-redirect = <0xffffffff 0x79 0x01>;
				gdsc_emac-supply = <0xffffffff>;
				pinctrl-names = "dev-emac-mdc", "dev-emac-mdio", "dev-emac-rgmii_txd0_state", "dev-emac-rgmii_txd1_state", "dev-emac-rgmii_txd2_state", "dev-emac-rgmii_txd3_state", "dev-emac-rgmii_txc_state", "dev-emac-rgmii_tx_ctl_state", "dev-emac-rgmii_rxd0_state", "dev-emac-rgmii_rxd1_state", "dev-emac-rgmii_rxd2_state", "dev-emac-rgmii_rxd3_state", "dev-emac-rgmii_rxc_state", "dev-emac-rgmii_rx_ctl_state", "dev-emac-phy_intr", "dev-emac-phy_reset_state", "dev-emac_pin_pps_0", "dev-emac-rgmii_rxc_suspend_state", "dev-emac-rgmii_rxc_resume_state";
				pinctrl-0 = <0xffffffff>;
				pinctrl-1 = <0xffffffff>;
				pinctrl-2 = <0xffffffff>;
				pinctrl-3 = <0xffffffff>;
				pinctrl-4 = <0xffffffff>;
				pinctrl-5 = <0xffffffff>;
				pinctrl-6 = <0xffffffff>;
				pinctrl-7 = <0xffffffff>;
				pinctrl-8 = <0xffffffff>;
				pinctrl-9 = <0xffffffff>;
				pinctrl-10 = <0xffffffff>;
				pinctrl-11 = <0xffffffff>;
				pinctrl-12 = <0xffffffff>;
				pinctrl-13 = <0xffffffff>;
				pinctrl-14 = <0xffffffff>;
				pinctrl-15 = <0xffffffff>;
				pinctrl-16 = <0xffffffff>;
				pinctrl-17 = <0xffffffff>;
				pinctrl-18 = <0xffffffff>;
				phandle = <0x09>;

				io-macro-info {
					io-macro-bypass-mode = <0x00>;
					io-interface = "rgmii";
				};

				emac_emb_smmu {
					compatible = "qcom,emac-smmu-embedded";
					iommus = <0xffffffff 0x1c0 0x00>;
					qcom,iova-mapping = <0x80000000 0x40000000>;
					phandle = <0x0a>;
				};
			};
		};
	};

	fragment@4 {
		target = <0xffffffff>;

		__overlay__ {
			compatible = "qcom,ufs-phy-qmp-v3-660";
			vdda-phy-supply = <0xffffffff>;
			vdda-pll-supply = <0xffffffff>;
			vdda-phy-max-microamp = <0x7530>;
			vdda-pll-max-microamp = <0x2ee0>;
			status = "ok";
		};
	};

	fragment@5 {
		target = <0xffffffff>;

		__overlay__ {
			vdd-hba-supply = <0xffffffff>;
			vdd-hba-fixed-regulator;
			vcc-supply = <0xffffffff>;
			vcc-voltage-level = <0x2d0370 0x2d2a80>;
			vccq2-supply = <0xffffffff>;
			vcc-max-microamp = "", "\f5";
			vccq2-max-microamp = <0x927c0>;
			qcom,vddp-ref-clk-supply = <0xffffffff>;
			qcom,vddp-ref-clk-max-microamp = <0x64>;
			qcom,vddp-ref-clk-min-uV = <0x12cc80>;
			qcom,vddp-ref-clk-max-uV = <0x1339e0>;
			status = "ok";
		};
	};

	fragment@6 {
		target = <0xffffffff>;

		__overlay__ {
			vdd-supply = <0xffffffff>;
			qcom,vdd-voltage-level = <0x2d0370 0x2d0370>;
			qcom,vdd-current-level = <0x00 0x8b290>;
			vdd-io-supply = <0xffffffff>;
			qcom,vdd-io-always-on;
			qcom,vdd-io-lpm-sup;
			qcom,vdd-io-voltage-level = <0x1b7740 0x1b7740>;
			qcom,vdd-io-current-level = <0x00 0x4f588>;
			pinctrl-names = "active", "sleep";
			pinctrl-0 = <0xffffffff 0xffffffff 0xffffffff 0xffffffff>;
			pinctrl-1 = <0xffffffff 0xffffffff 0xffffffff 0xffffffff>;
			qcom,restore-after-cx-collapse;
			status = "ok";
		};
	};

	fragment@7 {
		target = <0xffffffff>;

		__overlay__ {
			vdd-supply = <0xffffffff>;
			qcom,vdd-voltage-level = <0x2d0370 0x2d0370>;
			qcom,vdd-current-level = <0x00 0xc3500>;
			vdd-io-supply = <0xffffffff>;
			qcom,vdd-io-voltage-level = <0x1b7740 0x2f4d60>;
			qcom,vdd-io-current-level = <0x00 0x55f0>;
			pinctrl-names = "active", "sleep";
			pinctrl-0 = <0xffffffff 0xffffffff 0xffffffff 0xffffffff>;
			pinctrl-1 = <0xffffffff 0xffffffff 0xffffffff 0xffffffff>;
			cd-gpios = <0xffffffff 0x63 0x01>;
			qcom,restore-after-cx-collapse;
			status = "ok";
		};
	};

	fragment@8 {
		target = <0xffffffff>;

		__overlay__ {
			qcom,default-mode-none;
			qcom,ignore-wakeup-src-in-hostmode;
		};
	};

	fragment@9 {
		target = <0xffffffff>;

		__overlay__ {
			qcom,usb-hs-ac-bitmask = <0x30>;
			qcom,usb-hs-ac-value = <0x10>;
			pinctrl-names = "default";
			pinctrl-0 = <0xffffffff>;
		};
	};

	fragment@10 {
		target = <0xffffffff>;

		__overlay__ {
			status = "ok";
			qcom,default-mode-host;
			qcom,ignore-wakeup-src-in-hostmode;
		};
	};

	fragment@11 {
		target = <0xffffffff>;

		__overlay__ {
			qcom,usb-hs-ac-bitmask = <0xc0>;
			qcom,usb-hs-ac-value = <0x40>;
			pinctrl-names = "default";
			pinctrl-0 = <0xffffffff>;
		};
	};

	fragment@12 {
		target = <0xffffffff>;

		__overlay__ {
			status = "ok";
		};
	};

	fragment@13 {
		target = <0xffffffff>;

		__overlay__ {
			status = "ok";
		};
	};

	fragment@14 {
		target = <0xffffffff>;

		__overlay__ {
			status = "ok";
		};
	};

	__symbols__ {
		vreg_conn_1p8 = "/fragment@0/__overlay__/vreg_conn_1p8";
		vreg_conn_pa = "/fragment@0/__overlay__/vreg_conn_pa";
		vreg_wlan = "/fragment@0/__overlay__/vreg_wlan";
		bluetooth_ext = "/fragment@0/__overlay__/bt_qca6174";
		cnss_pcie = "/fragment@0/__overlay__/qcom,cnss-qca-converged";
		hsi2s = "/fragment@3/__overlay__/qcom,hsi2s";
		sdr0 = "/fragment@3/__overlay__/qcom,hsi2s/qcom,hs0_i2s";
		sdr1 = "/fragment@3/__overlay__/qcom,hsi2s/qcom,hs1_i2s";
		emac_hw = "/fragment@3/__overlay__/qcom,emac@20000";
		emac_emb_smmu = "/fragment@3/__overlay__/qcom,emac@20000/emac_emb_smmu";
	};

	__fixups__ {
		soc = "/fragment@0:target:0", "/fragment@3:target:0";
		pm6155_1_gpios = "/fragment@0/__overlay__/vreg_conn_1p8:gpio:0", "/fragment@0/__overlay__/vreg_conn_pa:gpio:0";
		bt_en_active = "/fragment@0/__overlay__/bt_qca6174:pinctrl-0:0";
		tlmm = "/fragment@0/__overlay__/bt_qca6174:qca,bt-reset-gpio:0", "/fragment@0/__overlay__/qcom,cnss-qca-converged:wlan-en-gpio:0", "/fragment@2/__overlay__/can-controller@0:interrupt-parent:0", "/fragment@3/__overlay__/qcom,emac@20000:interrupts-extended:32", "/fragment@3/__overlay__/qcom,emac@20000:qcom,phy-reset:0", "/fragment@3/__overlay__/qcom,emac@20000:qcom,phy-intr-redirect:0", "/fragment@7/__overlay__:cd-gpios:0";
		pm6155_1_s6 = "/fragment@0/__overlay__/bt_qca6174:qca,bt-vdd-vm-supply:0", "/fragment@0/__overlay__/qcom,cnss-qca-converged:vdd-wlan-rfa1-supply:0";
		pm6155_1_s5 = "/fragment@0/__overlay__/bt_qca6174:qca,bt-vdd-5a-supply:0", "/fragment@0/__overlay__/qcom,cnss-qca-converged:vdd-wlan-rfa2-supply:0";
		pm6155_1_l15 = "/fragment@0/__overlay__/bt_qca6174:qca,bt-vdd-vh-supply:0", "/fragment@0/__overlay__/qcom,cnss-qca-converged:vdd-wlan-rfa3-supply:0";
		cnss_wlan_en_active = "/fragment@0/__overlay__/qcom,cnss-qca-converged:pinctrl-0:0";
		cnss_wlan_en_sleep = "/fragment@0/__overlay__/qcom,cnss-qca-converged:pinctrl-1:0";
		qupv3_2 = "/fragment@1:target:0";
		qupv3_se6_spi = "/fragment@2:target:0";
		clock_gcc = "/fragment@3/__overlay__/qcom,hsi2s:clocks:0", "/fragment@3/__overlay__/qcom,hsi2s:clocks:8", "/fragment@3/__overlay__/qcom,hsi2s:clocks:16", "/fragment@3/__overlay__/qcom,hsi2s:clocks:24", "/fragment@3/__overlay__/qcom,hsi2s:clocks:32", "/fragment@3/__overlay__/qcom,hsi2s/qcom,hs0_i2s:clocks:0", "/fragment@3/__overlay__/qcom,hsi2s/qcom,hs1_i2s:clocks:0", "/fragment@3/__overlay__/qcom,emac@20000:clocks:0", "/fragment@3/__overlay__/qcom,emac@20000:clocks:8", "/fragment@3/__overlay__/qcom,emac@20000:clocks:16", "/fragment@3/__overlay__/qcom,emac@20000:clocks:24";
		hs0_i2s_sck_active = "/fragment@3/__overlay__/qcom,hsi2s/qcom,hs0_i2s:pinctrl-0:0";
		hs0_i2s_data0_active = "/fragment@3/__overlay__/qcom,hsi2s/qcom,hs0_i2s:pinctrl-0:4";
		hs0_i2s_data1_active = "/fragment@3/__overlay__/qcom,hsi2s/qcom,hs0_i2s:pinctrl-0:8";
		hs0_i2s_sck_sleep = "/fragment@3/__overlay__/qcom,hsi2s/qcom,hs0_i2s:pinctrl-1:0";
		hs0_i2s_data0_sleep = "/fragment@3/__overlay__/qcom,hsi2s/qcom,hs0_i2s:pinctrl-1:4";
		hs0_i2s_data1_sleep = "/fragment@3/__overlay__/qcom,hsi2s/qcom,hs0_i2s:pinctrl-1:8";
		apps_smmu = "/fragment@3/__overlay__/qcom,hsi2s/qcom,hs0_i2s:iommus:0", "/fragment@3/__overlay__/qcom,hsi2s/qcom,hs1_i2s:iommus:0", "/fragment@3/__overlay__/qcom,emac@20000/emac_emb_smmu:iommus:0";
		hs1_i2s_sck_active = "/fragment@3/__overlay__/qcom,hsi2s/qcom,hs1_i2s:pinctrl-0:0";
		hs1_i2s_data0_active = "/fragment@3/__overlay__/qcom,hsi2s/qcom,hs1_i2s:pinctrl-0:4";
		hs1_i2s_data1_active = "/fragment@3/__overlay__/qcom,hsi2s/qcom,hs1_i2s:pinctrl-0:8";
		hs1_i2s_sck_sleep = "/fragment@3/__overlay__/qcom,hsi2s/qcom,hs1_i2s:pinctrl-1:0";
		hs1_i2s_data0_sleep = "/fragment@3/__overlay__/qcom,hsi2s/qcom,hs1_i2s:pinctrl-1:4";
		hs1_i2s_data1_sleep = "/fragment@3/__overlay__/qcom,hsi2s/qcom,hs1_i2s:pinctrl-1:8";
		pdc = "/fragment@3/__overlay__/qcom,emac@20000:interrupts-extended:0", "/fragment@3/__overlay__/qcom,emac@20000:interrupts-extended:16", "/fragment@3/__overlay__/qcom,emac@20000:interrupts-extended:44", "/fragment@3/__overlay__/qcom,emac@20000:interrupts-extended:60", "/fragment@3/__overlay__/qcom,emac@20000:interrupts-extended:76", "/fragment@3/__overlay__/qcom,emac@20000:interrupts-extended:92", "/fragment@3/__overlay__/qcom,emac@20000:interrupts-extended:108", "/fragment@3/__overlay__/qcom,emac@20000:interrupts-extended:124", "/fragment@3/__overlay__/qcom,emac@20000:interrupts-extended:140", "/fragment@3/__overlay__/qcom,emac@20000:interrupts-extended:156", "/fragment@3/__overlay__/qcom,emac@20000:interrupts-extended:172", "/fragment@3/__overlay__/qcom,emac@20000:interrupts-extended:188", "/fragment@3/__overlay__/qcom,emac@20000:interrupts-extended:204";
		emac_gdsc = "/fragment@3/__overlay__/qcom,emac@20000:gdsc_emac-supply:0";
		emac_mdc = "/fragment@3/__overlay__/qcom,emac@20000:pinctrl-0:0";
		emac_mdio = "/fragment@3/__overlay__/qcom,emac@20000:pinctrl-1:0";
		emac_rgmii_txd0 = "/fragment@3/__overlay__/qcom,emac@20000:pinctrl-2:0";
		emac_rgmii_txd1 = "/fragment@3/__overlay__/qcom,emac@20000:pinctrl-3:0";
		emac_rgmii_txd2 = "/fragment@3/__overlay__/qcom,emac@20000:pinctrl-4:0";
		emac_rgmii_txd3 = "/fragment@3/__overlay__/qcom,emac@20000:pinctrl-5:0";
		emac_rgmii_txc = "/fragment@3/__overlay__/qcom,emac@20000:pinctrl-6:0";
		emac_rgmii_tx_ctl = "/fragment@3/__overlay__/qcom,emac@20000:pinctrl-7:0";
		emac_rgmii_rxd0 = "/fragment@3/__overlay__/qcom,emac@20000:pinctrl-8:0";
		emac_rgmii_rxd1 = "/fragment@3/__overlay__/qcom,emac@20000:pinctrl-9:0";
		emac_rgmii_rxd2 = "/fragment@3/__overlay__/qcom,emac@20000:pinctrl-10:0";
		emac_rgmii_rxd3 = "/fragment@3/__overlay__/qcom,emac@20000:pinctrl-11:0";
		emac_rgmii_rxc = "/fragment@3/__overlay__/qcom,emac@20000:pinctrl-12:0";
		emac_rgmii_rx_ctl = "/fragment@3/__overlay__/qcom,emac@20000:pinctrl-13:0";
		emac_phy_intr = "/fragment@3/__overlay__/qcom,emac@20000:pinctrl-14:0";
		emac_phy_reset_state = "/fragment@3/__overlay__/qcom,emac@20000:pinctrl-15:0";
		emac_pin_pps_0 = "/fragment@3/__overlay__/qcom,emac@20000:pinctrl-16:0";
		emac_rgmii_rxc_suspend = "/fragment@3/__overlay__/qcom,emac@20000:pinctrl-17:0";
		emac_rgmii_rxc_resume = "/fragment@3/__overlay__/qcom,emac@20000:pinctrl-18:0";
		ufsphy_mem = "/fragment@4:target:0";
		pm6155_1_l5 = "/fragment@4/__overlay__:vdda-phy-supply:0";
		pm6155_1_l12 = "/fragment@4/__overlay__:vdda-pll-supply:0";
		ufshc_mem = "/fragment@5:target:0";
		ufs_phy_gdsc = "/fragment@5/__overlay__:vdd-hba-supply:0";
		pm6155_1_l17 = "/fragment@5/__overlay__:vcc-supply:0", "/fragment@6/__overlay__:vdd-supply:0";
		pm6155_1_s4 = "/fragment@5/__overlay__:vccq2-supply:0", "/fragment@6/__overlay__:vdd-io-supply:0";
		pm6155_1_l11 = "/fragment@5/__overlay__:qcom,vddp-ref-clk-supply:0";
		sdhc_1 = "/fragment@6:target:0";
		sdc1_clk_on = "/fragment@6/__overlay__:pinctrl-0:0";
		sdc1_cmd_on = "/fragment@6/__overlay__:pinctrl-0:4";
		sdc1_data_on = "/fragment@6/__overlay__:pinctrl-0:8";
		sdc1_rclk_on = "/fragment@6/__overlay__:pinctrl-0:12";
		sdc1_clk_off = "/fragment@6/__overlay__:pinctrl-1:0";
		sdc1_cmd_off = "/fragment@6/__overlay__:pinctrl-1:4";
		sdc1_data_off = "/fragment@6/__overlay__:pinctrl-1:8";
		sdc1_rclk_off = "/fragment@6/__overlay__:pinctrl-1:12";
		sdhc_2 = "/fragment@7:target:0";
		pm6155_1_l10 = "/fragment@7/__overlay__:vdd-supply:0";
		pm6155_1_l2 = "/fragment@7/__overlay__:vdd-io-supply:0";
		sdc2_clk_on = "/fragment@7/__overlay__:pinctrl-0:0";
		sdc2_cmd_on = "/fragment@7/__overlay__:pinctrl-0:4";
		sdc2_data_on = "/fragment@7/__overlay__:pinctrl-0:8";
		sdc2_cd_on = "/fragment@7/__overlay__:pinctrl-0:12";
		sdc2_clk_off = "/fragment@7/__overlay__:pinctrl-1:0";
		sdc2_cmd_off = "/fragment@7/__overlay__:pinctrl-1:4";
		sdc2_data_off = "/fragment@7/__overlay__:pinctrl-1:8";
		sdc2_cd_off = "/fragment@7/__overlay__:pinctrl-1:12";
		usb0 = "/fragment@8:target:0";
		qusb_phy0 = "/fragment@9:target:0";
		usb0_hs_ac_en_default = "/fragment@9/__overlay__:pinctrl-0:0";
		usb1 = "/fragment@10:target:0";
		qusb_phy1 = "/fragment@11:target:0";
		usb1_hs_ac_en_default = "/fragment@11/__overlay__:pinctrl-0:0";
		qupv3_se0_2uart = "/fragment@12:target:0";
		qupv3_se5_i2c = "/fragment@13:target:0";
		qupv3_se7_4uart = "/fragment@14:target:0";
	};

	__local_fixups__ {

		fragment@0 {

			__overlay__ {

				bt_qca6174 {
					qca,bt-vdd-pa-supply = <0x00>;
					qca,bt-chip-pwd-supply = <0x00>;
				};

				qcom,cnss-qca-converged {
					vdd-wlan-ctrl1-supply = <0x00>;
					vdd-wlan-ctrl2-supply = <0x00>;
					vdd-wlan-supply = <0x00>;
				};
			};
		};
	};
};
